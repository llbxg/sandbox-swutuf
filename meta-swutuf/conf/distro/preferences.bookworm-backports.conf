## meta-swutuf/conf/layer.conf
```bitbake
BBPATH .= ":${LAYERDIR}"

BBFILES += "${LAYERDIR}/recipes-*/*/*.bb \
            ${LAYERDIR}/recipes-*/*/*.bbappend"

BBFILE_COLLECTIONS += "meta-swutuf"
BBFILE_PATTERN_meta-swutuf = "^${LAYERDIR}/"
BBFILE_PRIORITY_meta-swutuf = "7"

LAYERSERIES_COMPAT_meta-swutuf = "next"
```
